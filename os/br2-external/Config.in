## os/br2-external/configs/hifi_bridge_rpizero2w_64_defconfig
```kconfig
BR2_aarch64=y
BR2_ARM_FPU_VFPV4=y
BR2_TOOLCHAIN_EXTERNAL=y
BR2_TOOLCHAIN_EXTERNAL_BOOTLIN=y
BR2_TOOLCHAIN_EXTERNAL_BOOTLIN_AARCH64_GLIBC_STABLE=y
BR2_GLOBAL_PATCH_DIR="board/raspberrypi/patches"
BR2_DOWNLOAD_FORCE_CHECK_HASHES=y
BR2_REPRODUCIBLE=y
BR2_TARGET_GENERIC_HOSTNAME="hifi-bridge"
BR2_TARGET_GENERIC_ISSUE="Hi-Fi Bridge"
BR2_INIT_SYSTEMD=y
BR2_INIT_SYSTEMD_VAR_OVERLAYFS=y
# BR2_TARGET_ENABLE_ROOT_LOGIN is not set
# BR2_TARGET_GENERIC_REMOUNT_ROOTFS_RW is not set
BR2_ENABLE_LOCALE_WHITELIST="C en_US de_DE"
BR2_ROOTFS_OVERLAY="$(BR2_EXTERNAL_HIFI_BRIDGE_PATH)/board/hifi-bridge/overlay"
BR2_ROOTFS_POST_BUILD_SCRIPT="$(BR2_EXTERNAL_HIFI_BRIDGE_PATH)/board/hifi-bridge/post-build.sh"
BR2_ROOTFS_POST_IMAGE_SCRIPT="$(BR2_EXTERNAL_HIFI_BRIDGE_PATH)/board/hifi-bridge/post-image.sh"
BR2_LINUX_KERNEL=y
BR2_LINUX_KERNEL_CUSTOM_TARBALL=y
BR2_LINUX_KERNEL_CUSTOM_TARBALL_LOCATION="$(call github,raspberrypi,linux,21b410140c47ffab5668399f6f143c7d7b935c8b)/linux-21b410140c47ffab5668399f6f143c7d7b935c8b.tar.gz"
BR2_LINUX_KERNEL_DEFCONFIG="bcm2711"
BR2_LINUX_KERNEL_DTS_SUPPORT=y
BR2_LINUX_KERNEL_INTREE_DTS_NAME="broadcom/bcm2710-rpi-zero-2-w"
BR2_LINUX_KERNEL_INSTALL_TARGET=y
BR2_LINUX_KERNEL_NEEDS_HOST_OPENSSL=y
BR2_PACKAGE_PIPEWIRE=y
BR2_PACKAGE_WIREPLUMBER=y
BR2_PACKAGE_XZ=y
BR2_PACKAGE_E2FSPROGS=y
BR2_PACKAGE_E2FSPROGS_RESIZE2FS=y
BR2_PACKAGE_BRCMFMAC_SDIO_FIRMWARE_RPI=y
BR2_PACKAGE_BRCMFMAC_SDIO_FIRMWARE_RPI_BT=y
BR2_PACKAGE_BRCMFMAC_SDIO_FIRMWARE_RPI_WIFI=y
BR2_PACKAGE_RPI_FIRMWARE=y
BR2_PACKAGE_RPI_FIRMWARE_BOOTCODE_BIN=y
BR2_PACKAGE_RPI_FIRMWARE_VARIANT_PI=y
BR2_PACKAGE_RPI_FIRMWARE_CONFIG_FILE="$(BR2_EXTERNAL_HIFI_BRIDGE_PATH)/board/hifi-bridge/firmware/config_zero2w_64bit.txt"
BR2_PACKAGE_RPI_FIRMWARE_CMDLINE_FILE="$(BR2_EXTERNAL_HIFI_BRIDGE_PATH)/board/hifi-bridge/firmware/cmdline.txt"
BR2_PACKAGE_UBOOT_TOOLS=y
BR2_PACKAGE_LUA=y
BR2_PACKAGE_PYTHON3=y
BR2_PACKAGE_PYTHON3_ZLIB=y
BR2_PACKAGE_LIBSNDFILE=y
BR2_PACKAGE_SBC=y
BR2_PACKAGE_CA_CERTIFICATES=y
BR2_PACKAGE_LIBOPENSSL_BIN=y
BR2_PACKAGE_AVAHI=y
BR2_PACKAGE_AVAHI_DAEMON=y
BR2_PACKAGE_BLUEZ5_UTILS=y
BR2_PACKAGE_DNSMASQ=y
BR2_PACKAGE_HOSTAPD=y
BR2_PACKAGE_HOSTAPD_WPA3=y
BR2_PACKAGE_IW=y
BR2_PACKAGE_NFTABLES=y
BR2_PACKAGE_WIRELESS_REGDB=y
BR2_PACKAGE_WPA_SUPPLICANT=y
BR2_PACKAGE_WPA_SUPPLICANT_WPA3=y
BR2_PACKAGE_WPA_SUPPLICANT_CTRL_IFACE=y
BR2_PACKAGE_RAUC=y
BR2_PACKAGE_RAUC_DBUS=y
BR2_PACKAGE_RAUC_JSON=y
BR2_PACKAGE_UTIL_LINUX_BINARIES=y
BR2_PACKAGE_UTIL_LINUX_PARTX=y
BR2_TARGET_ROOTFS_EXT2=y
BR2_TARGET_ROOTFS_EXT2_4=y
BR2_TARGET_ROOTFS_EXT2_SIZE="256M"
BR2_TARGET_ROOTFS_EXT2_MKFS_OPTIONS="-O ^64bit -b 4096 -U 8d3b1c54-2f0e-4a51-9c7e-3f1a6e0b9d21 -E hash_seed=8d3b1c54-2f0e-4a51-9c7e-3f1a6e0b9d21"
# BR2_TARGET_ROOTFS_TAR is not set
BR2_TARGET_UBOOT=y
BR2_TARGET_UBOOT_BOARD_DEFCONFIG="rpi_arm64"
BR2_TARGET_UBOOT_NEEDS_OPENSSL=y
BR2_TARGET_UBOOT_NEEDS_GNUTLS=y
BR2_PACKAGE_HOST_DOSFSTOOLS=y
BR2_PACKAGE_HOST_GENIMAGE=y
BR2_PACKAGE_HOST_KMOD_XZ=y
BR2_PACKAGE_HOST_MTOOLS=y
BR2_PACKAGE_HOST_PYTHON3_SSL=y
BR2_PACKAGE_HOST_RAUC=y
BR2_PACKAGE_HOST_UBOOT_TOOLS=y
BR2_PACKAGE_HOST_UBOOT_TOOLS_BOOT_SCRIPT=y
BR2_PACKAGE_HOST_UBOOT_TOOLS_BOOT_SCRIPT_SOURCE="$(BR2_EXTERNAL_HIFI_BRIDGE_PATH)/board/hifi-bridge/uboot/boot.cmd"
BR2_PACKAGE_HIFI_BRIDGE=y
BR2_PACKAGE_HIFI_BRIDGE_COMPATIBLE="hifi-bridge-rpizero2w"
```

## os/br2-external/package/hifi-bridge/Config.in
```kconfig
config BR2_PACKAGE_HIFI_BRIDGE
	bool "hifi-bridge"
	depends on BR2_PACKAGE_PYTHON3
	select BR2_PACKAGE_PYTHON3_SSL
	select BR2_PACKAGE_PYTHON_JEEPNEY
	help
	  Hi-Fi Bridge appliance service (Bluetooth A2DP sink -> Lyrion).
	  Installs the Python package to /usr/lib/hifi-bridge and the
	  systemd units. See docs/PHASE2B_PLAN.md.

if BR2_PACKAGE_HIFI_BRIDGE

config BR2_PACKAGE_HIFI_BRIDGE_COMPATIBLE
	string "RAUC compatible string"
	help
	  Must be identical to the official image of the same board if
	  official update bundles shall be accepted (docs/UPDATE_TRUST.md).

config BR2_PACKAGE_HIFI_BRIDGE_BUILD_VARIANT
	string "build variant"
	default "development"
	help
	  "development" for every image that is not an official release
	  (the default; such images are NOT hardware-validated). Only the
	  release process sets "release", and only together with official
	  update trust. Recorded in /usr/lib/os-release (VARIANT_ID), in
	  /etc/hifi-bridge/build-info.json and in the image file name.

choice
	prompt "Accepted update signatures (explicit)"
	default BR2_PACKAGE_HIFI_BRIDGE_UPDATE_TRUST_UNSET
	help
	  Which update bundles this image accepts. There is deliberately no
	  usable default: the post-build step fails until a choice is made.
	  docs/UPDATE_TRUST.md explains the consequences.

config BR2_PACKAGE_HIFI_BRIDGE_UPDATE_TRUST_UNSET
	bool "not configured (the build fails)"

config BR2_PACKAGE_HIFI_BRIDGE_UPDATE_TRUST_OFFICIAL
	bool "official releases only"

config BR2_PACKAGE_HIFI_BRIDGE_UPDATE_TRUST_OWN
	bool "own update CA only"

config BR2_PACKAGE_HIFI_BRIDGE_UPDATE_TRUST_OFFICIAL_AND_OWN
	bool "official releases and own update CA"

endchoice

config BR2_PACKAGE_HIFI_BRIDGE_OWN_UPDATE_CA
	string "own update CA certificate (PEM, public part only)"
	depends on BR2_PACKAGE_HIFI_BRIDGE_UPDATE_TRUST_OWN || BR2_PACKAGE_HIFI_BRIDGE_UPDATE_TRUST_OFFICIAL_AND_OWN

config BR2_PACKAGE_HIFI_BRIDGE_OFFICIAL_UPDATE_CA
	string "official release CA certificate (PEM, public part only)"
	default "$(BR2_EXTERNAL_HIFI_BRIDGE_PATH)/board/hifi-bridge/keys/release-ca.pem"
	depends on BR2_PACKAGE_HIFI_BRIDGE_UPDATE_TRUST_OFFICIAL || BR2_PACKAGE_HIFI_BRIDGE_UPDATE_TRUST_OFFICIAL_AND_OWN

endif
```
